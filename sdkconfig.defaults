## sdkconfig.defaults
```kconfig
# Target ESP32-P4 hw_ver3 (revision >= 3.0) — production WHY2025 badge hardware
# CONFIG_ESP32P4_SELECTS_REV_LESS_V3 is not set
CONFIG_ESP32P4_REV_MIN_300=y

CONFIG_BOOTLOADER_APP_ROLLBACK_ENABLE=y
# CONFIG_BOOTLOADER_WDT_ENABLE is not set
CONFIG_ESPTOOLPY_FLASHSIZE_16MB=y
CONFIG_PARTITION_TABLE_CUSTOM=y
CONFIG_COMPILER_OPTIMIZATION_PERF=y
CONFIG_COMPILER_WARN_WRITE_STRINGS=y
CONFIG_COMPILER_SAVE_RESTORE_LIBCALLS=y
# CONFIG_ANA_CMPR_ISR_HANDLER_IN_IRAM is not set
# CONFIG_GPTIMER_ISR_HANDLER_IN_IRAM is not set
# CONFIG_I2C_MASTER_ISR_HANDLER_IN_IRAM is not set
# CONFIG_MCPWM_ISR_HANDLER_IN_IRAM is not set
# CONFIG_PARLIO_TX_ISR_HANDLER_IN_IRAM is not set
# CONFIG_PARLIO_RX_ISR_HANDLER_IN_IRAM is not set
# CONFIG_RMT_ENCODER_FUNC_IN_IRAM is not set
# CONFIG_RMT_TX_ISR_HANDLER_IN_IRAM is not set
# CONFIG_RMT_RX_ISR_HANDLER_IN_IRAM is not set
CONFIG_SPI_MASTER_IN_IRAM=y
# CONFIG_SPI_SLAVE_ISR_IN_IRAM is not set
# CONFIG_ETH_USE_ESP32_EMAC is not set
# CONFIG_ETH_USE_SPI_ETHERNET is not set
# CONFIG_ESP_EVENT_POST_FROM_ISR is not set
CONFIG_ESP_HTTP_CLIENT_ENABLE_BASIC_AUTH=y
CONFIG_ESP_HTTP_CLIENT_ENABLE_DIGEST_AUTH=y
CONFIG_DMA2D_OPERATION_FUNC_IN_IRAM=y
CONFIG_DMA2D_ISR_IRAM_SAFE=y
CONFIG_ESP_BROWNOUT_DET_LVL_SEL_5=y
CONFIG_LCD_DSI_ISR_IRAM_SAFE=y
# CONFIG_ESP_NETIF_REPORT_DATA_TRAFFIC is not set
CONFIG_SPIRAM=y
CONFIG_SPIRAM_SPEED_200M=y
# CONFIG_SPIRAM_BOOT_INIT is not set
CONFIG_SPIRAM_USE_MEMMAP=y
CONFIG_CACHE_L2_CACHE_256KB=y
CONFIG_CACHE_L2_CACHE_LINE_128B=y
CONFIG_ESP_SYSTEM_PANIC_REBOOT_DELAY_SECONDS=5
# CONFIG_ESP_SYSTEM_PMP_IDRAM_SPLIT is not set
CONFIG_ESP_MAIN_TASK_STACK_SIZE=8192
# CONFIG_ESP_INT_WDT is not set
# CONFIG_ESP_TASK_WDT_EN is not set
# CONFIG_ESP_DEBUG_OCDAWARE is not set
CONFIG_FATFS_LFN_HEAP=y
CONFIG_FATFS_USE_DYN_BUFFERS=y
CONFIG_FREERTOS_THREAD_LOCAL_STORAGE_POINTERS=2
CONFIG_FREERTOS_TIMER_TASK_AFFINITY_CPU0=y
CONFIG_FREERTOS_TASK_NOTIFICATION_ARRAY_ENTRIES=2
CONFIG_FREERTOS_USE_APPLICATION_TASK_TAG=y
CONFIG_FREERTOS_TASK_PRE_DELETION_HOOK=y
CONFIG_LOG_DEFAULT_LEVEL_WARN=y
CONFIG_LWIP_LOCAL_HOSTNAME="why2025badge"
CONFIG_LWIP_TCPIP_CORE_LOCKING=y
CONFIG_LWIP_TCPIP_CORE_LOCKING_INPUT=y
CONFIG_LWIP_CHECK_THREAD_SAFETY=y
# CONFIG_LWIP_DNS_SUPPORT_MDNS_QUERIES is not set
CONFIG_LWIP_IP4_REASSEMBLY=y
CONFIG_LWIP_IP6_REASSEMBLY=y
CONFIG_LWIP_DHCP_OPTIONS_LEN=69
# CONFIG_LWIP_DHCPS is not set
CONFIG_LWIP_AUTOIP=y
CONFIG_LWIP_IPV6_AUTOCONFIG=y
CONFIG_LWIP_IPV6_DHCP6=y
CONFIG_LWIP_TCPIP_TASK_AFFINITY_CPU0=y
CONFIG_LWIP_DNS_MAX_SERVERS=2
CONFIG_LWIP_DNS_SETSERVER_WITH_NETIF=y
# CONFIG_LWIP_ESP_LWIP_ASSERT is not set
CONFIG_MBEDTLS_SSL_PROTO_TLS1_3=y
CONFIG_LIBC_OPTIMIZED_MISALIGNED_ACCESS=y
CONFIG_PTHREAD_DEFAULT_CORE_1=y
CONFIG_SPI_FLASH_SUPPORT_GD_CHIP=y
# CONFIG_SPI_FLASH_ENABLE_ENCRYPTED_READ_WRITE is not set
# CONFIG_WS_TRANSPORT is not set
# CONFIG_ELF_LOADER_LOAD_PSRAM is not set
# CONFIG_ELF_LOADER_ESPIDF_SYMBOLS is not set
CONFIG_ESP_HOSTED_PRIV_SDIO_PIN_CMD_SLOT_1=33
CONFIG_ESP_HOSTED_PRIV_SDIO_PIN_CLK_SLOT_1=32
CONFIG_ESP_HOSTED_PRIV_SDIO_PIN_D0_SLOT_1=28
CONFIG_ESP_HOSTED_PRIV_SDIO_PIN_D1_4BIT_BUS_SLOT_1=31
CONFIG_ESP_HOSTED_PRIV_SDIO_PIN_D2_4BIT_BUS_SLOT_1=30
CONFIG_ESP_HOSTED_PRIV_SDIO_PIN_D3_4BIT_BUS_SLOT_1=29
CONFIG_ESP_HOSTED_SDIO_GPIO_RESET_SLAVE=13
CONFIG_WIFI_RMT_STATIC_TX_BUFFER=y
# CONFIG_WIFI_RMT_IRAM_OPT is not set
# CONFIG_WIFI_RMT_EXTRA_IRAM_OPT is not set
# CONFIG_WIFI_RMT_RX_IRAM_OPT is not set
# CONFIG_WIFI_RMT_SLP_IRAM_OPT is not set
# CONFIG_WIFI_RMT_SOFTAP_SUPPORT is not set
CONFIG_WIFI_RMT_WAPI_PSK=y
CONFIG_WIFI_RMT_ENT_FREE_DYNAMIC_BUFFER=y
CONFIG_IDF_EXPERIMENTAL_FEATURES=y
```
